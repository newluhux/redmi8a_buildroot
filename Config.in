## Config.in
```kconfig
source "$BR2_EXTERNAL_REDMI8A_PATH/package/libufdt/Config.in"
source "$BR2_EXTERNAL_REDMI8A_PATH/package/libufdt/Config.in.host"
source "$BR2_EXTERNAL_REDMI8A_PATH/package/msm-fb-refresher/Config.in"
```

## buildroot-2022.02.6/configs/redmi8a_defconfig
```kconfig
# target
BR2_aarch64=y
BR2_cortex_a53=y

# toolchain
BR2_TOOLCHAIN_BUILDROOT_MUSL=y
BR2_PACKAGE_HOST_LINUX_HEADERS_CUSTOM_4_9=y

# kernel
BR2_LINUX_KERNEL=y
BR2_LINUX_KERNEL_CUSTOM_TARBALL=y
BR2_LINUX_KERNEL_CUSTOM_TARBALL_LOCATION="https://github.com/MiCode/Xiaomi_Kernel_OpenSource/archive/f3335576f443d206b866b9847ae514ed1b173fe1.tar.gz"
BR2_LINUX_KERNEL_PATCH="$(BR2_EXTERNAL_REDMI8A_PATH)/board/redmi8a/linux/patches"
BR2_LINUX_KERNEL_DEFCONFIG="olive-perf"
BR2_LINUX_KERNEL_ZSTD=y

# package
BR2_PACKAGE_LRZSZ=y

# images
BR2_TARGET_ROOTFS_CPIO=y
BR2_TARGET_ROOTFS_CPIO_ZSTD=y
BR2_TARGET_ROOTFS_INITRAMFS=y

# host
BR2_PACKAGE_HOST_ABOOTIMG=y
BR2_PACKAGE_HOST_ANDROID_TOOLS=y
BR2_PACKAGE_HOST_ANDROID_TOOLS_FASTBOOT=y
```

## configs/redmi8a_defconfig
```kconfig
# target
BR2_aarch64=y
BR2_cortex_a53=y

# toolchain
BR2_PACKAGE_HOST_LINUX_HEADERS_CUSTOM_4_9=y
BR2_TOOLCHAIN_BUILDROOT_MUSL=y
BR2_PACKAGE_HOST_GDB=y

# system
BR2_ROOTFS_POST_IMAGE_SCRIPT="$(BR2_EXTERNAL_REDMI8A_PATH)/board/redmi8a/post-image.sh"
BR2_ROOTFS_OVERLAY="$(BR2_EXTERNAL_REDMI8A_PATH)/board/redmi8a/overlay/"
BR2_ROOTFS_MERGED_USR=y

# kernel
BR2_LINUX_KERNEL=y
BR2_LINUX_KERNEL_CUSTOM_TARBALL=y
BR2_LINUX_KERNEL_CUSTOM_TARBALL_LOCATION="https://github.com/MiCode/Xiaomi_Kernel_OpenSource/archive/f3335576f443d206b866b9847ae514ed1b173fe1.tar.gz"
BR2_LINUX_KERNEL_PATCH="$(BR2_EXTERNAL_REDMI8A_PATH)/board/redmi8a/linux/patches"
BR2_LINUX_KERNEL_DEFCONFIG="olive-perf"
BR2_LINUX_KERNEL_CONFIG_FRAGMENT_FILES="$(BR2_EXTERNAL_REDMI8A_PATH)/board/redmi8a/linux/linux-4.9-extra.config"
BR2_LINUX_KERNEL_IMAGE_TARGET_CUSTOM=y
BR2_LINUX_KERNEL_IMAGE_NAME="Image.gz-dtb"

# package
BR2_PACKAGE_BUSYBOX_WATCHDOG=y
BR2_PACKAGE_LRZSZ=y
BR2_PACKAGE_SCREEN=y
BR2_PACKAGE_ABOOTIMG=y

# images
BR2_TARGET_ROOTFS_CPIO=y
BR2_TARGET_ROOTFS_CPIO_GZIP=y

# host
BR2_PACKAGE_HOST_ABOOTIMG=y
BR2_PACKAGE_HOST_ANDROID_TOOLS=y
BR2_PACKAGE_HOST_ANDROID_TOOLS_FASTBOOT=y
BR2_PACKAGE_HOST_DTC=y
```

## package/libufdt/Config.in
```kconfig
config BR2_PACKAGE_LIBUFDT
	bool "libufdt"
	select BR2_PACKAGE_PYTHON3
	help
	 mkdtboimg  

	 https://android.googlesource.com/platform/system/libufdt/
```

## package/libufdt/Config.in.host
```kconfig
config BR2_PACKAGE_HOST_LIBUFDT
	bool "host libufdt"
	select BR2_PACKAGE_HOST_PYTHON3
	help
	 mkdtboimg  

	 https://android.googlesource.com/platform/system/libufdt/
```

## package/msm-fb-refresher/Config.in
```kconfig
config BR2_PACKAGE_MSM_FB_REFRESHER
	bool "msm-fb-refresher"
	help
	 fix buggy msm framebuffer

	 https://github.com/AsteroidOS/msm-fb-refresher
```
